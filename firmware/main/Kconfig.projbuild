## firmware/main/Kconfig.projbuild
```kconfig
menu "CR11 bridge configuration"

config CR11_BRIDGE_PRIMARY_CHANNEL_MASK
    hex "Primary BDB commissioning channel mask"
    range 0x00000800 0x07fff800
    default 0x07fff800
    help
        Bits 11 through 26 select the channels scanned first by BDB Network
        Steering. Channels not selected here are used as the secondary
        fallback set. The public release scans all 16 channels as primary.

config CR11_BRIDGE_RETRY_MS
    int "Commissioning retry delay in milliseconds"
    range 1000 60000
    default 5000

config CR11_UI_BOOT_GPIO
    int "BOOT button GPIO"
    range 0 30
    default 9
    help
        Active-low BOOT button input on ESP32-C6-DevKitC-1.

config CR11_UI_RGB_GPIO
    int "Addressable RGB LED GPIO"
    range 0 30
    default 8
    help
        Data GPIO for the onboard addressable RGB LED.

choice CR11_UI_RGB_ORDER
    prompt "Addressable RGB LED colour component order"
    default CR11_UI_RGB_ORDER_GRB
    help
        Byte order the onboard addressable LED expects. The ESP32-C6-DevKitC-1
        carries a GRB part, which is the released default. Some boards, such as
        the Waveshare ESP32-C6-Zero, carry an RGB part; with the wrong setting
        red and green are exchanged, so a factory-new device appears to pulse
        green instead of red. Yellow and blue render identically in both
        orders, which makes the BOOT hold and steering phases a reliable way to
        confirm that only the colour order is wrong.

config CR11_UI_RGB_ORDER_GRB
    bool "GRB (WS2812, ESP32-C6-DevKitC-1)"

config CR11_UI_RGB_ORDER_RGB
    bool "RGB"

endchoice

config CR11_UI_LED_BRIGHTNESS
    int "Maximum RGB component brightness"
    range 1 255
    default 32
    help
        Maximum component value used for the status LED. Half-yellow uses
        half this value.

config CR11_UI_UART_RX_BUFFER
    int "UART command RX buffer size"
    range 256 4096
    default 512

config CR11_UI_VIRTUAL_HOLD_LIMIT_MS
    int "Maximum virtual BOOT hold"
    range 6000 60000
    default 15000
    help
        Safety auto-release for a UART-injected BOOT press if the sender
        disconnects before issuing `boot release`.

endmenu
```

## firmware/sdkconfig.defaults
```kconfig
CONFIG_ESPTOOLPY_FLASHSIZE_8MB=y
CONFIG_APP_REPRODUCIBLE_BUILD=y
CONFIG_PARTITION_TABLE_CUSTOM=y
CONFIG_PARTITION_TABLE_CUSTOM_FILENAME="partitions.csv"
CONFIG_ZB_ENABLED=y
CONFIG_ZB_ZED=y
CONFIG_LOG_DEFAULT_LEVEL_INFO=y
CONFIG_ESP_BROWNOUT_DET=y
CONFIG_ESP_BROWNOUT_DET_LVL_SEL_7=y
CONFIG_ESP_TASK_WDT_EN=y
CONFIG_ESP_TASK_WDT_INIT=y
CONFIG_ESP_TASK_WDT_PANIC=y
CONFIG_ESP_TASK_WDT_TIMEOUT_S=5
CONFIG_ESP_CONSOLE_UART_DEFAULT=y
CONFIG_ESP_CONSOLE_SECONDARY_NONE=y
CONFIG_ESP_CONSOLE_UART_BAUDRATE=115200
```
